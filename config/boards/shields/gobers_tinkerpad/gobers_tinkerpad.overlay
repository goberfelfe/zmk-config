/ {
    chosen {
        zmk,kscan = &kscan0;
    };

    kscan0: kscan {
        compatible = "zmk,kscan-gpio-matrix";

        row-gpios = <&gpio0 1 0>, <&gpio0 2 0>, <&gpio0 3 0>, <&gpio0 4 0>;
        col-gpios = <&gpio0 11 0>, <&gpio0 10 0>, <&gpio0 9 0>, <&gpio0 8 0>;

        diode-direction = "col2row";
    };
};
